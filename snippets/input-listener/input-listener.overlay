#include <input/processors.dtsi>
#include <zephyr/dt-bindings/input/input-event-codes.h>
#include <dt-bindings/zmk/input_transform.h>

// スクロール時に横方向スクロール無効化定義
input_processors {
    zip_scroll_x_scaler: zip_scroll_x_scaler {
        compatible = "zmk,input-processor-scaler";
        #input-processor-cells = <2>;
        type = <INPUT_EV_REL>;
        codes = <INPUT_REL_HWHEEL>;
        track-remainders;
    };
};

&pointing_listener {
    status = "okay";
    device = <&pointing_device>;
    compatible = "zmk,input-listener";

    // 通常スクロール処理
    input-processors = <
        &zip_xy_transform (INPUT_TRANSFORM_X_INVERT | INPUT_TRANSFORM_Y_INVERT)
        &zip_xy_scaler 3 4
        &zip_temp_layer 4 700
    >;

    // スクロールレイヤーの有効化
    scroller {
        layers = <3>;
        input-processors = <
            &zip_xy_transform (INPUT_TRANSFORM_X_INVERT | INPUT_TRANSFORM_Y_INVERT)
            &zip_xy_scaler 1 (-1)
            &zip_xy_to_scroll_mapper
            &zip_scroll_x_scaler 0 1
        >;
    };
};
